## conf/distro/include/raspberrypi_generic.conf
```bitbake
PACKAGECONFIG_append_pn-wpeframework = " virtualinput"

PACKAGECONFIG_append_pn-wpeframework-clientlibraries = "\
    displayinfo deviceinfo cryptography cryptography_openssl playerinfo \
"

PACKAGECONFIG_append_pn-wpeframework-plugins = "\
    dialserver dial_youtube filetransfer inputswitch languageadministrator \
    power processmonitor resourcemonitor svalbard systemcommands webproxy webshell \
    streamer streamer_cenc \
"

PACKAGECONFIG_append_pn-wpeframework-plugins-rdk = " displayinfo messenger packager playerinfo"

DISTROOVERRIDES .= ":${DISTRO_CODENAME}"

# Set groups/users in distro scope
# Please enable these setting if you need to enable user:group permissions for thunder
#WPEFRAMEWORK_GROUP = "thunder"
#WPEFRAMEWORK_SUPER_USER_GROUP = "root"
#WPEFRAMEWORK_PLATFORM_VIDEO_DEVICE_GROUP = "video"
#WPEFRAMEWORK_OCDM_GROUP = "${@bb.utils.contains('DISTRO_FEATURES', 'opencdm', 'ocdm', '', d)}"
#WPEFRAMEWORK_OCDM_SUPER_USER_GROUP = "root"
#WPE_COBALT_USER = "cobalt"
#WPE_COBALT_SUPER_USER_GROUP = "root"
#WPE_WEBKITBROWSER_USER = "wpewebkit"
#WPE_WEBKITBROWSER_SUPER_USER_GROUP = "root"

#PLUGIN_AMAZON_PRIME_USER = "amazon"
#PLUGIN_AMAZON_PRIME_SUPER_USER_GROUP = "root"
#PLUGIN_NETFLIX_USER = "netflix"
#PLUGIN_NETFLIX_SUPER_USER_GROUP = "root"

# Set data path
WPEFRAMEWORK_DATA_PATH = "/usr/share/WPEFramework"

# Select packages based on distro name selection
require raspberrypi_generic_dunfell.conf
require raspberrypi_generic_morty.conf
```

## conf/distro/include/raspberrypi_generic_dunfell.conf
```bitbake
PACKAGECONFIG_append_pn-wpeframework_dunfell = " ${@bb.utils.contains('DISTRO_FEATURES', 'container', 'processcontainers processcontainers_lxc', '', d)}"
PACKAGECONFIG_append_pn-wpeframework-plugins_dunfell = " ${@bb.utils.contains('DISTRO_FEATURES', 'container', 'processcontainers', '', d)}"

PREFERRED_VERSION_gstreamer1.0-omx_dunfell = "1.16.%"
PREFERRED_VERSION_linux-raspberrypi_dunfell = "5.10.%"
```

## conf/distro/include/raspberrypi_generic_morty.conf
```bitbake
PREFERRED_VERSION_cmake = "3.7.%"
PREFERRED_VERSION_gstreamer1.0 = "1.10.4"
PREFERRED_VERSION_gstreamer1.0-libav = "1.10.4"
PREFERRED_VERSION_gstreamer1.0-plugins-bad = "1.10.4"
PREFERRED_VERSION_gstreamer1.0-plugins-base = "1.10.4"
PREFERRED_VERSION_gstreamer1.0-plugins-good = "1.10.4"
PREFERRED_VERSION_gstreamer1.0-plugins-ugly = "1.10.4"
PREFERRED_VERSION_gstreamer1.0-omx = "1.10.4"
PREFERRED_VERSION_linux-raspberrypi = "4.9.%"

DISTRO_FEATURES_append = " ${DISTRO_FEATURES_LIBC}"

BBMASK_append = " meta-wpe-restricted/recipes-connectivity/openssl/openssl10_1.0.%.bbappend"
BBMASK_append = " meta-wpe/recipes-graphics/mesa"
BBMASK_append = " meta-wpe/recipes-graphics/cairo/cairo_1.16.0.bbappend"
BBMASK_append = " meta-wpe/recipes-graphics/drm"
BBMASK_append = " meta-wpe/recipes-support/libsoup/libsoup-2.4_2.58.1.bbappend"
BBMASK_append = " meta-metrological-raspberrypi/recipes-bsp/bootfiles/bootfiles.bbappend"
BBMASK_append = " meta-wpe/recipes-multimedia/gstreamer/gstreamer1.0_1.16.%.bbappend|meta-wpe/recipes-multimedia/gstreamer/gstreamer1.0-plugins-bad_1.16.%.bbappend meta-wpe/recipes-multimedia/gstreamer/gstreamer1.0-plugins-base_1.16%.bbappend meta-wpe/recipes-multimedia/gstreamer/gstreamer1.0-plugins-good_1.16.%.bbappend meta-wpe/recipes-multimedia/gstreamer/gstreamer1.0_1.16.%.bbappend meta-wpe/recipes-multimedia/gstreamer/gstreamer1.0-omx_1.16.%.bbappend"
```

## conf/layer.conf
```bitbake
BBPATH .= ":${LAYERDIR}"

BBFILES += "\
            ${LAYERDIR}/recipes-*/*/*.bb \
            ${LAYERDIR}/recipes-*/*/*.bbappend \
           "

BBFILE_COLLECTIONS += "wpe-ml-layer"
BBFILE_PATTERN_wpe-ml-layer := "^${LAYERDIR}/"
BBFILE_PRIORITY_wpe-ml-layer = "20"

LAYERSERIES_COMPAT_wpe-ml-layer = "morthy sumo thud warrior zeus dunfell gatesgarth"

LAYERDEPENDS_wpe-ml-layer = " wpe-layer"

BBFILES_DYNAMIC += " \
    raspberrypi:${LAYERDIR}/dynamic-layers/recipes-*/*/*.bb \
    raspberrypi:${LAYERDIR}/dynamic-layers/recipes-*/*/*.bbappend \
"

LICENSE_PATH += "${LAYERDIR}/licenses"

# WPE needs mpg123 gstreamer plugin
LICENSE_FLAGS_WHITELIST += "commercial_mpg123"
LICENSE_FLAGS_WHITELIST += "commercial_gstreamer1.0-plugins-ugly"

LICENSE_FLAGS_WHITELIST += "${@bb.utils.contains('MACHINE_FEATURES', 'vc4graphics', 'commercial_gstreamer1.0-libav', '', d)}"

# WPE needs gstreamer plugins that need faad2
LICENSE_FLAGS_WHITELIST += "commercial_faad2"

# WPE on rpi needs the OpenMAX gstreamer plugin 
LICENSE_FLAGS_WHITELIST += "commercial_libomxil" 
LICENSE_FLAGS_WHITELIST += "commercial_gstreamer1.0-omx"

PREFERRED_VERSION_wpewebkit = "2.22%"
PREFERRED_VERSION_libwpe = "1.0.0%"
PREFERRED_VERSION_wpebackend-rdk = "git%"

PREFERRED_VERSION_icu = "65.%"
PREFERRED_PROVIDER_virtual/wpebackend = "wpebackend-rdk"

# enable wayland-egl for rpi
PACKAGECONFIG_append_pn-userland += " wayland"
```
